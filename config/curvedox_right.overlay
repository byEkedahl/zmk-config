/*
 * Copyright (c) 2020 The ZMK Contributors
 *
 * SPDX-License-Identifier: MIT
 */
 /*
  * Fixed for Curvedox
  */

#include "curvedox.dtsi"

&default_transform {
	col-offset = <5>;
};

&oled {
	segment-remap;
	com-invdir;
};

&kscan0 {
	col-gpios
		= <&feather_header 6 GPIO_ACTIVE_HIGH>
		, <&feather_header 7 GPIO_ACTIVE_HIGH>
		, <&feather_header 8 GPIO_ACTIVE_HIGH>
		, <&feather_header 9 GPIO_ACTIVE_HIGH>
		, <&feather_header 10 GPIO_ACTIVE_HIGH>
		, <&feather_header 11 GPIO_ACTIVE_HIGH>
		;
};
